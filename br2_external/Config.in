## br2_external/Config.in
```kconfig
source "$BR2_EXTERNAL_RASPIPLAY_PATH/package/fm-transmitter/Config.in"
source "$BR2_EXTERNAL_RASPIPLAY_PATH/package/pifmadv/Config.in"
source "$BR2_EXTERNAL_RASPIPLAY_PATH/package/radio-tools/Config.in"
```

## br2_external/configs/raspiplay_zero_w_defconfig
```kconfig
BR2_arm=y
BR2_arm1176jzf_s=y
BR2_TOOLCHAIN_EXTERNAL=y
BR2_TOOLCHAIN_EXTERNAL_BOOTLIN_ARMV6_EABIHF_GLIBC_STABLE=y
BR2_GLOBAL_PATCH_DIR="board/raspberrypi/patches"
BR2_DOWNLOAD_FORCE_CHECK_HASHES=y

BR2_INIT_BUSYBOX=y
BR2_SYSTEM_BIN_SH_BUSYBOX=y
BR2_TARGET_GENERIC_HOSTNAME="radio-sender"
BR2_TARGET_GENERIC_ISSUE="Raspiplay Radio Sender"
BR2_TARGET_ENABLE_ROOT_LOGIN=y
BR2_TARGET_GENERIC_ROOT_PASSWD="radio"
BR2_TARGET_GENERIC_GETTY_PORT="tty1"
# BR2_TARGET_GENERIC_REMOUNT_ROOTFS_RW is not set
BR2_ROOTFS_USERS_TABLES="$(BR2_EXTERNAL_RASPIPLAY_PATH)/board/raspiplay/users_table.txt"

BR2_ROOTFS_OVERLAY="$(BR2_EXTERNAL_RASPIPLAY_PATH)/../rootfs_overlay"
BR2_ROOTFS_POST_BUILD_SCRIPT="$(BR2_EXTERNAL_RASPIPLAY_PATH)/scripts/post-build.sh"
BR2_ROOTFS_POST_IMAGE_SCRIPT="support/scripts/genimage.sh"
BR2_ROOTFS_POST_SCRIPT_ARGS="-c $(BR2_EXTERNAL_RASPIPLAY_PATH)/board/raspiplay/genimage.cfg"

BR2_LINUX_KERNEL=y
BR2_LINUX_KERNEL_CUSTOM_TARBALL=y
BR2_LINUX_KERNEL_CUSTOM_TARBALL_LOCATION="$(call github,raspberrypi,linux,21b410140c47ffab5668399f6f143c7d7b935c8b)/linux-21b410140c47ffab5668399f6f143c7d7b935c8b.tar.gz"
BR2_LINUX_KERNEL_DEFCONFIG="bcmrpi"
BR2_LINUX_KERNEL_DTS_SUPPORT=y
BR2_LINUX_KERNEL_INTREE_DTS_NAME="broadcom/bcm2708-rpi-zero-w"
BR2_LINUX_KERNEL_NEEDS_HOST_OPENSSL=y
BR2_LINUX_KERNEL_CONFIG_FRAGMENT_FILES="$(BR2_EXTERNAL_RASPIPLAY_PATH)/board/raspiplay/linux-fragment.config"

BR2_TARGET_ROOTFS_INITRAMFS=y
BR2_TARGET_ROOTFS_CPIO=y
BR2_TARGET_ROOTFS_CPIO_GZIP=y
# BR2_TARGET_ROOTFS_EXT2 is not set
# BR2_TARGET_ROOTFS_TAR is not set

BR2_PACKAGE_BUSYBOX=y
BR2_PACKAGE_BUSYBOX_CONFIG_FRAGMENT_FILES="$(BR2_EXTERNAL_RASPIPLAY_PATH)/board/raspiplay/busybox-fragment.config"
BR2_PACKAGE_BUSYBOX_SHOW_OTHERS=y
BR2_PACKAGE_BUSYBOX_HTTPD=y
BR2_PACKAGE_BASH=y
BR2_PACKAGE_KMOD=y
BR2_PACKAGE_KMOD_TOOLS=y

BR2_PACKAGE_RPI_FIRMWARE=y
BR2_PACKAGE_RPI_FIRMWARE_BOOTCODE_BIN=y
BR2_PACKAGE_RPI_FIRMWARE_VARIANT_PI=y
BR2_PACKAGE_RPI_FIRMWARE_CONFIG_FILE="$(BR2_EXTERNAL_RASPIPLAY_PATH)/board/raspiplay/config_0w.txt"
BR2_PACKAGE_BRCMFMAC_SDIO_FIRMWARE_RPI=y
BR2_PACKAGE_BRCMFMAC_SDIO_FIRMWARE_RPI_BT=y
BR2_PACKAGE_BRCMFMAC_SDIO_FIRMWARE_RPI_WIFI=y
BR2_PACKAGE_XZ=y

BR2_PACKAGE_DBUS=y
BR2_PACKAGE_BLUEZ5_UTILS=y
BR2_PACKAGE_BLUEZ5_UTILS_CLIENT=y
BR2_PACKAGE_BLUEZ5_UTILS_TOOLS=y
BR2_PACKAGE_BLUEZ5_UTILS_DEPRECATED=y
BR2_PACKAGE_BLUEZ5_UTILS_PLUGINS_AUDIO=y
BR2_PACKAGE_BLUEZ_TOOLS=y
BR2_PACKAGE_BLUEZ_ALSA=y

BR2_PACKAGE_ALSA_LIB=y
BR2_PACKAGE_ALSA_LIB_MIXER=y
BR2_PACKAGE_ALSA_PLUGINS=y
BR2_PACKAGE_ALSA_UTILS=y
BR2_PACKAGE_ALSA_UTILS_APLAY=y

BR2_PACKAGE_HOSTAPD=y
BR2_PACKAGE_HOSTAPD_DRIVER_NL80211=y
BR2_PACKAGE_DNSMASQ=y
BR2_PACKAGE_DNSMASQ_DHCP=y
BR2_PACKAGE_WPA_SUPPLICANT=y
BR2_PACKAGE_WPA_SUPPLICANT_NL80211=y
BR2_PACKAGE_WPA_SUPPLICANT_CLI=y
BR2_PACKAGE_WPA_SUPPLICANT_PASSPHRASE=y
BR2_PACKAGE_DROPBEAR=y
BR2_PACKAGE_DROPBEAR_DISABLE_REVERSEDNS=y

BR2_PACKAGE_LIBSNDFILE=y
BR2_PACKAGE_LIBSOXR=y
BR2_PACKAGE_FM_TRANSMITTER=y
BR2_PACKAGE_PIFMADV=y

BR2_PACKAGE_HOST_DOSFSTOOLS=y
BR2_PACKAGE_HOST_GENIMAGE=y
BR2_PACKAGE_HOST_KMOD_XZ=y
BR2_PACKAGE_HOST_MTOOLS=y
```

## br2_external/package/fm-transmitter/Config.in
```kconfig
config BR2_PACKAGE_FM_TRANSMITTER
	bool "fm_transmitter"
	depends on BR2_arm
	depends on BR2_INSTALL_LIBSTDCPP
	help
	  Simple Raspberry Pi FM transmitter for GPIO4 live audio.

	  https://github.com/markondej/fm_transmitter
```

## br2_external/package/pifmadv/Config.in
```kconfig
config BR2_PACKAGE_PIFMADV
	bool "pifmadv"
	depends on BR2_arm
	select BR2_PACKAGE_LIBSNDFILE
	select BR2_PACKAGE_LIBSOXR
	help
	  PiFmAdv FM transmitter for Raspberry Pi GPIO 4.

	  This package cross-compiles the Pi 1/Zero ARMv6 binary.
```

## br2_external/package/radio-tools/Config.in
```kconfig
config BR2_PACKAGE_RADIO_TOOLS
	bool "radio-tools"
	help
	  Small audio helpers for the Raspberry Pi FM radio image.
```
